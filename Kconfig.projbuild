## Kconfig.projbuild
```kconfig
menu "Gemini API Configuration"

    config GEMINI_API_KEY
        string "Gemini API Key"
        default "YOUR_API_KEY_HERE"
        help
            Enter your Google AI Gemini API key.

    config WIFI_SSID
        string "WiFi SSID"
        default "YOUR_WIFI_SSID"

    config WIFI_PASSWORD
        string "WiFi Password"
        default "YOUR_WIFI_PASSWORD"
endmenu
```

## sdkconfig.defaults
```kconfig
CONFIG_MBEDTLS_CERTIFICATE_BUNDLE=y
CONFIG_SPIRAM=y
CONFIG_SPIRAM_MODE_OCT=y
CONFIG_ESP_WIFI_CACHE_TX_BUFFER_NUM=16
CONFIG_SPIRAM_USE_MALLOC=y
```
